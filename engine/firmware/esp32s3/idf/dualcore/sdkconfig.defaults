## packages/engine/tests/firmware/esp32s3/idf/screen/sdkconfig.defaults
```kconfig
CONFIG_LV_COLOR_DEPTH_16=y
CONFIG_LV_MEM_SIZE_KILOBYTES=96
CONFIG_LV_DEF_REFR_PERIOD=33
CONFIG_LV_OS_NONE=y
CONFIG_LV_FONT_MONTSERRAT_14=y
CONFIG_LV_FONT_MONTSERRAT_48=y
# CONFIG_LV_BUILD_EXAMPLES is not set
# CONFIG_LV_BUILD_DEMOS is not set
```
